/*
 * Copyright (C) 2013 Texas Instruments Incorporated - http://www.ti.com/
 *
 * This program is free software; you can redistribute it and/or modify
 * it under the terms of the GNU General Public License version 2 as
 * published by the Free Software Foundation.
 */

/* AM43 Zebu */

/dts-v1/;

/include/ "am4372.dtsi"

/ {
	model = "TI AM43 Zebu";
	compatible = "ti,am43-zebu","ti,am4372","ti,am43";

	memory {
		device_type = "memory";
		reg = <0x80000000 0x08000000>; /* 128 MB */
	};

	chosen {
		bootargs = "console=ttyO0,115200n8 root=/dev/ram rw initrd=0x82000000,16MB ramdisk_size=65536 earlyprintk lpj=4063232 quiet init=/sbin/init";
	};
};

&uart1 {
	clock-frequency = <48000000>;
};
