/*
 * Copyright (C) 2012 Texas Instruments Incorporated - http://www.ti.com/
 *
 * This program is free software; you can redistribute it and/or modify
 * it under the terms of the GNU General Public License version 2 as
 * published by the Free Software Foundation.
 */
/dts-v1/;

/include/ "ti81xx.dtsi"

/ {
	model = "TI 816x EVM";
	compatible = "ti,ti816x-evm", "ti,ti81xx";

	memory {
		device_type = "memory";
		reg = <0x80000000 0x10000000>; /* 256 MB */
	};

	ocp {
		uart3: serial@48024000 {
			status = "okay";
		};
	};
};
